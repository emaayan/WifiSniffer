## Esp32Sniffer/components/WifiSniffer/Kconfig.projbuild
```kconfig
menu "Sniffer Configuration"

	choice WIFI_CONNECT_METHOD
		prompt "Wifi Connectiom Method"
		default WIFI_SOFTAP
		help
			Connection Method

		config WIFI_NONE
			bool "None"
		config WIFI_SOFTAP
			bool "SoftAp"
		config WIFI_STA
			bool "Station"
	endchoice

	config SOFTAP_WIFI_SSID
		depends on WIFI_SOFTAP
        string "WiFi SSID"
        default "myssid"
        help
            SSID (network name).

    config SOFTAP_WIFI_PASSWORD
		depends on WIFI_SOFTAP
        string "WiFi Password"
        default "mypassword"
        help
            WiFi password (WPA or WPA2) for soft ap.

    config SOFTAP_WIFI_CHANNEL
		depends on WIFI_SOFTAP
        int "Soft AP WiFi Channel"
        range 1 13
        default 1
        help
            WiFi channel (network channel).

	config SOFTAP_WIFI_IP
		depends on WIFI_SOFTAP
		string "IP For SoftAP"
		default "192.168.19.1"
		help
			Initial IP for Soft AP mode.

    config MAX_STA_CONN_TO_AP
		depends on WIFI_SOFTAP
        int "Maximal STA connections"
        default 4
        help
            Max number of the STA connects to AP.

	config STA_WIFI_SSID
		depends on WIFI_STA
		string "WiFi SSID"
		default "myssid"
		help
			SSID (network name).

	config STA_WIFI_PASSWORD
		depends on WIFI_STA
		string "Station WiFi Password"
		default "mypassword"
		help
			WiFi password (WPA or WPA2).
		
	config CHANNEL
		depends on WIFI_NONE
		int "Sniffing channel"
		range 1 13
		default 11
		help
			Channel in which ESP32 will sniff PROBE REQUEST
	
	config SNIFFING_TIME
		depends on WIFI_NONE
		int "Time of sniffig in seconds"
		default 60
		help
			Time must be in seconds
		
	config TCP_SERVER_PORT
		int "Port"
		range 0 65535
		default 19000
		help
			Local port the example server will listen on.

	config TCP_SERVER_KEEPALIVE_IDLE
		int "TCP keep-alive idle time(s)"
		default 5
		help
			Keep-alive idle time. In idle time without receiving any data from peer, will send keep-alive probe packet

	config TCP_SERVER_KEEPALIVE_INTERVAL
		int "TCP keep-alive interval time(s)"
		default 5
		help
			Keep-alive probe packet interval time.

	config TCP_SERVER_KEEPALIVE_COUNT
		int "TCP keep-alive packet retry send counts"
		default 3
		help
			Keep-alive probe packet retry count.

endmenu
```

## Esp32Sniffer/components/wifi_lib/Kconfig.projbuild
```kconfig
menu "Wifi Initial Configuration"
	

	choice WIFI_CONNECT_METHOD
		prompt "Wifi Connectiom Method"
		default WIFI_SOFTAP
		help
			Connection Method

		config WIFI_NONE
			bool "None"
		config WIFI_SOFTAP
			bool "SoftAp"
		config WIFI_STA
			bool "Station"
	endchoice

	config SOFTAP_WIFI_SSID
		depends on WIFI_SOFTAP
        string "WiFi AP SSID"
        default "sniff"
        help
            SSID prefix  (network name).

    config SOFTAP_WIFI_PASSWORD
		depends on WIFI_SOFTAP
        string "WiFi Password"
        default "mypassword"
        help
            WiFi password (WPA or WPA2) for soft ap.

    config SOFTAP_WIFI_CHANNEL
	
        int "Soft AP WiFi Channel"
        range 1 13
        default 1
        help
            WiFi channel (network channel).

	config SOFTAP_WIFI_IP
		
		string "IP For SoftAP"
		default "192.168.19.1"
		help
			Initial IP for Soft AP mode.

    config MAX_STA_CONN_TO_AP		
        int "Maximal STA connections"
        default 4
        help
            Max number of the STA connects to AP.

	config STA_WIFI_SSID		
		string "WiFi SSID"
		default "ssidtojoin"
		help
			SSID (network name).

	config STA_WIFI_PASSWORD		
		string "Station WiFi Password"
		default "mypassword"
		help
			WiFi password (WPA or WPA2).

endmenu
```

## Esp32Sniffer/components/wifi_sniffer/Kconfig.projbuild
```kconfig
menu "Sniffer Configuration"

	config SNIFFER_QUEUE_SIZE
		int "QueueSize"
		range 30 200
		default 100
		help
			Sniffer Queue Size

					
	config CHANNEL
		int "Sniffing channel"
		range 1 13
		default 11
		help
			Channel in which ESP32 will sniff PROBE REQUEST
		
	config SNIFFER_SNAP_LEN
		int "SnapLen"
		range 200 2500
		default 1000
		help
			Sniffer Maximum Packet Szie

	
	config SNIFFING_TIME
		depends on WIFI_NONE
		int "Time of sniffig in seconds"
		default 60
		help
			Time must be in seconds
	
endmenu
```

## Esp32Sniffer/sdkconfig.defaults
```kconfig
CONFIG_BT_ENABLED=n
CONFIG_BT_BLUEDROID_ENABLED=n
CONFIG_BT_NIMBLE_ENABLED=n

CONFIG_BTDM_CTRL_MODE_BLE_ONLY=y
CONFIG_BTDM_CTRL_MODE_BR_EDR_ONLY=n
CONFIG_BTDM_CTRL_MODE_BTDM=n

CONFIG_ESPTOOLPY_FLASHSIZE="4MB"
CONFIG_ESPTOOLPY_FLASHSIZE_4MB=y
CONFIG_PARTITION_TABLE_CUSTOM=y
CONFIG_PARTITION_TABLE_CUSTOM_FILENAME="partitions.csv"
CONFIG_PARTITION_TABLE_OFFSET=0x8000
CONFIG_PARTITION_TABLE_MD5=y

CONFIG_MAX_STA_CONN_TO_AP=4

#
# Wifi Initial Configuration
#

CONFIG_WIFI_SOFTAP=y
CONFIG_SOFTAP_WIFI_SSID="sniff"
CONFIG_SOFTAP_WIFI_PASSWORD="mypassword"
CONFIG_SOFTAP_WIFI_CHANNEL=1
CONFIG_SOFTAP_WIFI_IP="192.168.19.1"

CONFIG_WIFI_STA=n
CONFIG_STA_WIFI_SSID="ssidtojoin"
CONFIG_STA_WIFI_PASSWORD="mypassword"

#
# Sniffer Configuration
#
CONFIG_SNIFFER_QUEUE_SIZE=80
CONFIG_CHANNEL=11
CONFIG_SNIFFER_SNAP_LEN=1000


CONFIG_ESP_CONSOLE_SECONDARY_NONE=y

#CONFIG_NOT_LILIGO=1
#CONFIG_USE_OLED=1
#CONFIG_USE_LCD=1

# end of Sniffer Configuration
```

## Esp32Sniffer/sdkconfig.defaults.liligo
```kconfig
CONFIG_IDF_TARGET="esp32s3"

#CONFIG_ESP_CONSOLE_UART_DEFAULT=n
#CONFIG_ESP_CONSOLE_SECONDARY_NONE=n
#CONFIG_ESP_CONSOLE_UART_NUM=-1

#CONFIG_ESP_CONSOLE_SECONDARY_USB_SERIAL_JTAG=n
#CONFIG_APPTRACE_DEST_UART0=y


#CONFIG_ESP_CONSOLE_USB_SERIAL_JTAG=y # for liligo

#CONFIG_BLINK_LED_MOCK=y #this is for lilygo as it has no led

#CONFIG_LILIGO_S3=false

#CONFIG_NOT_LILIGO=true
```
